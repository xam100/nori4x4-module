/*
 * Copyright (c) 2020 The ZMK Contributors
 *
 * SPDX-License-Identifier: MIT
 *  "matrix_pins":
 *  "cols": ["F4", "F5", "F6", "F7", "B1", "B3", "B2", "B6", "D4", "C6", "D7", "E6"]
 *  "rows": ["D3", "D2", "D1", "D0"]
 *  = rows: 1,0,2,3
 *  = cols: 39,38,37,36     9,10,11,30      4,5,6,7
 */


/ {
    chosen {
        zmk,kscan = &kscan0;
    };

    kscan0: kscan {
        compatible = "zmk,kscan-gpio-matrix";
        wakeup-source;
        diode-direction = "col2row";

         row-gpios
            = <&pro_micro 1 (GPIO_ACTIVE_HIGH | GPIO_PULL_DOWN)>
            , <&pro_micro 0 (GPIO_ACTIVE_HIGH | GPIO_PULL_DOWN)>
            , <&pro_micro 2 (GPIO_ACTIVE_HIGH | GPIO_PULL_DOWN)>
            , <&pro_micro 3 (GPIO_ACTIVE_HIGH | GPIO_PULL_DOWN)>
            ;

        col-gpios
            = <&pro_micro 39 GPIO_ACTIVE_HIGH>
            , <&pro_micro 38 GPIO_ACTIVE_HIGH>
            , <&pro_micro 37 GPIO_ACTIVE_HIGH>
            , <&pro_micro 36 GPIO_ACTIVE_HIGH>
            ;
    };
};