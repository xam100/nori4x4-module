## config/Kconfig.defconfig
```kconfig
# Copyright (c) 2020 The ZMK Contributors
# SPDX-License-Identifier: MIT

if SHIELD_NORI4X4

config ZMK_KEYBOARD_NAME
    default "Nori 4x4"

endif
```

## config/Kconfig.shield
```kconfig
# Copyright (c) 2020 The ZMK Contributors
# SPDX-License-Identifier: MIT

config SHIELD_NORI4X4
    def_bool $(shields_list_contains,nori4x4)
```
